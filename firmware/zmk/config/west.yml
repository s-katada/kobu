## firmware/zmk/config/west.yml
```yaml
# kobu ZMK firmware — west manifest.
#
# This file is the single source of truth for the ZMK version and all external
# modules. zmk-nix (firmware/zmk/flake.nix) consumes it verbatim: its
# fetchZephyrDeps writes `.west/config` pointing here and runs `west update`,
# so pinning ZMK + the modules here pins the entire build. The fixed-output
# `zephyrDepsHash` in flake.nix freezes the resolved result.
#
# Revisions match KobitoKey_QWERTY (the ZMK keyboard kobu's keymap was ported
# from) so kobu inherits the exact, proven ZMK 0.3 + PMW3610 + RGB-LED-widget
# stack. sensor_rotation is intentionally NOT included: kobu uses raw trackball
# axes (the RMK firmware applies no rotation — see firmware/rmk/src/trackball.rs),
# unlike KobitoKey which rotates 70°/24° for its angled ball mounts.
manifest:
  remotes:
    - name: zmkfirmware
      url-base: https://github.com/zmkfirmware
    - name: caksoylar
      url-base: https://github.com/caksoylar

  projects:
    # ZMK core. `import: app/west.yml` transitively pulls Zephyr + all HALs.
    - name: zmk
      remote: zmkfirmware
      revision: v0.3
      import: app/west.yml

    # NOTE: the PMW3610 trackball driver is NOT fetched from badjeff here — it is
    # VENDORED (and patched to poll over SPI, since kobu's MOTION/P0_28 line is
    # unreliable) under modules/zmk-pmw3610-driver, wired in via the repo-root
    # zephyr/module.yml (cmake/kconfig/dts_root). See that module.yml.

    # Onboard RGB LED status widget (drives the rgbled_adapter shield).
    # Pinned to the v0.3 release tag (matches ZMK v0.3): `main` has moved to a
    # newer ZMK endpoint API (zmk_endpoint_get_selected) and renamed the XIAO
    # board overlay to xiao_ble_zmk.overlay, both of which break against ZMK
    # v0.3 + seeeduino_xiao_ble. The v0.3 tag uses zmk_endpoints_selected and
    # ships boards/seeeduino_xiao_ble.overlay (correct led-red/green/blue
    # aliases). KobitoKey pinned `main` but built before that drift.
    - name: zmk-rgbled-widget
      remote: caksoylar
      revision: v0.3

  self:
    path: config
```

## v1/firmware/zmk/config/boards/shields/kobu/Kconfig.defconfig
```kconfig
# Left = central
if SHIELD_KOBU_LEFT

config ZMK_KEYBOARD_NAME
    default "kobu"

config ZMK_SPLIT_ROLE_CENTRAL
    default y

endif

# Both halves
if SHIELD_KOBU_LEFT || SHIELD_KOBU_RIGHT

config ZMK_SPLIT
    default y

config ZMK_POINTING
    default y

config SPI
    default y

endif
```

## v1/firmware/zmk/config/boards/shields/kobu/Kconfig.shield
```kconfig
config SHIELD_KOBU_LEFT
    def_bool $(shields_list_contains,kobu_left)

config SHIELD_KOBU_RIGHT
    def_bool $(shields_list_contains,kobu_right)
```

## v1/firmware/zmk/modules/zmk-pmw3610-driver/Kconfig
```kconfig
# Sensor data simulator
#
# Copyright (c) 2019 Nordic Semiconductor
#
# SPDX-License-Identifier: LicenseRef-Nordic-5-Clause
#

menuconfig PMW3610
  bool "PMW3610 mouse optical sensor"
  select SPI
  depends on INPUT
  depends on DT_HAS_PIXART_PMW3610_ENABLED
  help
      Enable PMW3610 mouse optical sensor.

if PMW3610

config INPUT_PMW3610_INIT_PRIORITY
    int "PMW3610 initialization priority"
    default INPUT_INIT_PRIORITY

config PMW3610_SWAP_XY
  bool "Swap the X/Y axis of PMW3610 sensor"

config PMW3610_INVERT_X
  bool "Invert the X axis of PMW3610 sensor"

config PMW3610_INVERT_Y
  bool "Invert the Y axis of PMW3610 sensor"

config PMW3610_INIT_POWER_UP_EXTRA_DELAY_MS
  int "Extra power up init delay (ms)"
  default 0
  help
    Default minimum init power up delay is 10ms.
    Use this config to postpone init power up sequence if needs longer bootup time.

config PMW3610_REPORT_INTERVAL_MIN
	int "PMW3610's default minimum report rate"
	default 0
	help
	  Default minimum report interval in milliseconds.
		Slow down input reporting for hid queue over the air.
		Turn value down to 8ms to get sharp response if use with USB only.

config PMW3610_POLL_INTERVAL_MS
	int "PMW3610 IRQ-independent motion poll interval (ms, 0 = disabled)"
	default 0
	help
	  When > 0, periodically read the motion burst register over SPI every
	  N ms regardless of the MOTION (irq-gpios) interrupt line, in addition
	  to the normal IRQ-driven path. Use this when the MOTION line is
	  unreliable or unwired (kobu's PCB). 8-15 ms recommended; the IRQ path
	  remains active. kobu patch — not in upstream badjeff/zmk-pmw3610-driver.

config PMW3610_MAX_DELTA
	int "Reject single-sample deltas with |dx|/|dy| above this (0 = disabled)"
	default 0
	help
	  When > 0, any decoded per-sample delta whose magnitude exceeds this raw
	  count is zeroed. A real hand-roll never produces such a delta in one
	  sample, but a PARTIAL flaky-SPI read (a corrupted XY_H high nibble) decodes
	  to a huge value that an un-clamped scroll scaler turns into a sudden "gyun"
	  jump. 90 matches RMK's SCROLL_MAX_UNITS(3)×SCROLL_STEP(30) ceiling. Enable
	  on the flaky-SPI scroll half only; leave unset on the pointer half so fast
	  cursor flicks are never capped. kobu patch — not in upstream badjeff driver.

config PMW3610_SMART_ALGORITHM
  bool "Enable an algorithm of PMW3610 to enhance surface coverage"
  default y
  help
    Enable the integration of the smart algorithm as the datasheet implementation.
    The algorithm is used to extend the tracking acrocss a wider range of surfaces
    such as graniles and tiles.

config PMW3610_RUN_DOWNSHIFT_TIME_MS
    int "PMW3610's default RUN mode downshift time"
    default 128
    range 13 3264
    help
      Default RUN mode downshift down time in milliseconds.
      Time after which sensor goes from RUN to REST1 mode.

config PMW3610_REST1_DOWNSHIFT_TIME_MS
    int "PMW3610's default REST1 mode downshift time"
    default 5000
    help
      Default REST1 mode downshift down time in milliseconds.
      Time after which sensor goes from REST1 to REST2 mode.

config PMW3610_REST2_DOWNSHIFT_TIME_MS
    int "PMW3610's default REST2 mode downshift time"
    default 17000
    help
      Default REST2 mode downshift down time in milliseconds.
      Time after which sensor goes from REST2 to REST3 mode.

config PMW3610_REST1_SAMPLE_TIME_MS
    int "PMW3610's sample time in REST1 stage"
    default 40
    # range 10 2550
    help
      Default REST1 mode sample period in millisecond

config PMW3610_REST2_SAMPLE_TIME_MS
    int "PMW3610's sample time in REST2 stage"
    default 100
    # range 10 2550
    help
      Default REST2 mode sample period in millisecond.

config PMW3610_REST3_SAMPLE_TIME_MS
    int "PMW3610's sample time in REST3 stage"
    default 500
    # range 10 2550
    help
      Default REST2 mode sample period in millisecond.

module = PMW3610
module-str = PMW3610
source "${ZEPHYR_BASE}/subsys/logging/Kconfig.template.log_config"

endif #PMW3610
```
